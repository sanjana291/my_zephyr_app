## boards/calixto/imxrt1176_som/board.yml
```yaml
board:
  name: imxrt1176_som
  full_name: iMXRT1176 SOM Calixto
  vendor: calixto
  socs:
    - name: mimxrt1176
```

## drivers/ethernet/phy/Kconfig
```kconfig
config PHY_TI_DP83822
	bool "TI DP83822 PHY Driver"
	default y
	select MDIO
	depends on DT_HAS_TI_DP83822_ENABLED
	help
	  Enable TI DP83822 Ethernet PHY Driver
```

## dts/bindings/rs-485/calixto,rs-485.yaml
```yaml
description: Calixto RS-485 transceiver attached to a UART
compatible: "calixto,rs-485"

include: base.yaml
on-bus: uart

properties:
  rs-485-gpios:
    type: phandle-array
    required: true
    description: DE/RE control pin (active = transmit)

  post-tx-delay-us:
    type: int
    default: 0
    description: |
      Delay after the last byte is written, before releasing the bus.
      Roughly one character time, e.g. ~100 us at 115200 8N1.
```

## west.yml
```yaml
manifest:
  remotes:
    - name: zephyrproject-rtos
      url-base: https://github.com/zephyrproject-rtos

  projects:
    - name: zephyr
      remote: zephyrproject-rtos
      revision: v4.4.2
      import:
        name-allowlist:
          - cmsis
          - cmsis_6
          - hal_nxp
          - mcuboot
          - tinycrypt
          - mbedtls
          - zcbor
          - littlefs
          - open-amp
          - libmetal
          - fatfs
          - lvgl
```
